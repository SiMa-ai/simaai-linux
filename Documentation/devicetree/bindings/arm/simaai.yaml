## Documentation/devicetree/bindings/arm/simaai.yaml
```yaml
# SPDX-License-Identifier: (GPL-2.0-only OR BSD-2-Clause)
%YAML 1.2
---
$id: http://devicetree.org/schemas/arm/simaai.yaml#
$schema: http://devicetree.org/meta-schemas/core.yaml#

title: SiMa.ai Modalix Platforms

maintainers:
  - Bharanidharan Ramalingam <bharanidharan.ramalingam@sima.ai>

description: SiMa.ai Modalix MLSoC.

properties:
  $nodename:
    const: '/'
  compatible:
    const: simaai,modalix

additionalProperties: true
```

## Documentation/devicetree/bindings/media/i2c/onsemi,ar0234.yaml
```yaml
# SPDX-License-Identifier: (GPL-2.0-only OR BSD-2-Clause)
%YAML 1.2
---
$id: http://devicetree.org/schemas/media/i2c/onsemi,ar0234.yaml#
$schema: http://devicetree.org/meta-schemas/core.yaml#

title: onsemi AR0234 MIPI CSI-2 global shutter sensor

maintainers:
  - Punit Singh <punit.singh@sima.ai>

description:
  The AR0234 is a 1920x1200 global shutter raw CMOS image sensor with a
  MIPI CSI-2 output of up to four lanes and an I2C control interface.

allOf:
  - $ref: /schemas/media/video-interface-devices.yaml#

properties:
  compatible:
    const: onsemi,ar0234

  reg:
    maxItems: 1

  clocks:
    maxItems: 1
    description: XCLK input, 27 MHz.

  clock-names:
    const: xclk

  vana-supply:
    description: Analog (2.8 V) supply.

  vdig-supply:
    description: Digital core (1.8 V) supply.

  vddl-supply:
    description: Interface (1.2 V) supply.

  reset-gpios:
    description: Reset (RESET_BAR) input.
    maxItems: 1

  port:
    $ref: /schemas/graph.yaml#/$defs/port-base
    unevaluatedProperties: false

    properties:
      endpoint:
        $ref: /schemas/media/video-interfaces.yaml#
        unevaluatedProperties: false

        properties:
          data-lanes:
            oneOf:
              - items:
                  - const: 1
                  - const: 2
              - items:
                  - const: 1
                  - const: 2
                  - const: 3
                  - const: 4

          link-frequencies:
            minItems: 1
            maxItems: 4
            description:
              198 MHz to 450 MHz each; the per-lane bit rate is twice the link
              frequency.

        required:
          - data-lanes
          - link-frequencies

required:
  - compatible
  - reg
  - clocks
  - vana-supply
  - vdig-supply
  - vddl-supply
  - port

unevaluatedProperties: false

examples:
  - |
    i2c {
        #address-cells = <1>;
        #size-cells = <0>;

        camera@10 {
            compatible = "onsemi,ar0234";
            reg = <0x10>;
            clocks = <&ar0234_clk>;
            clock-names = "xclk";
            vana-supply = <&ar0234_vana>;
            vdig-supply = <&ar0234_vdig>;
            vddl-supply = <&ar0234_vddl>;

            port {
                ar0234_out: endpoint {
                    remote-endpoint = <&csi_in>;
                    data-lanes = <1 2>;
                    link-frequencies = /bits/ 64 <270000000>;
                };
            };
        };
    };
```

## Documentation/devicetree/bindings/media/i2c/sony,imx568.yaml
```yaml
# SPDX-License-Identifier: (GPL-2.0 OR BSD-2-Clause)
%YAML 1.2
---
$id: http://devicetree.org/schemas/media/i2c/sony,imx568.yaml#
$schema: http://devicetree.org/meta-schemas/core.yaml#

title: Sony IMX568 CMOS Image Sensor

maintainers:
  - Punit Singh <punit.singh@sima.ai>

description: |-
  The Sony IMX568 is a 1/1.8-inch global-shutter CMOS image sensor with a
  driver-exposed 2464 x 2064 native pixel array. Sony's all-pixel timing row
  applies to ROI widths through 2472 pixels. The sensor is programmed through
  I2C and outputs RAW data over a two- or four-lane MIPI CSI-2 interface.

allOf:
  - $ref: /schemas/media/video-interface-devices.yaml#

$defs:
  endpoint:
    $ref: /schemas/media/video-interfaces.yaml#
    unevaluatedProperties: false

    properties:
      data-lanes:
        oneOf:
          - items:
              - const: 1
              - const: 2
          - items:
              - const: 1
              - const: 2
              - const: 3
              - const: 4

      link-frequencies:
        minItems: 1
        maxItems: 3
        items:
          enum: [297000000, 445500000, 594000000]

      clock-continuous:
        type: boolean
        description:
          Downstream-only legacy compatibility marker with no effect on the
          driver. It is not part of the generic video-interface binding. New
          device trees omit both clock-continuous and clock-noncontinuous to
          select continuous mode.

      clock-noncontinuous: false

    required:
      - data-lanes
      - link-frequencies

  port:
    $ref: /schemas/graph.yaml#/$defs/port-base
    unevaluatedProperties: false

    properties:
      endpoint:
        $ref: '#/$defs/endpoint'

    required:
      - endpoint

properties:
  compatible:
    const: sony,imx568

  reg:
    maxItems: 1

  clocks:
    maxItems: 1
    description:
      Sensor INCK. The driver implements the Sony 37.125 MHz register profile.

  clock-names:
    items:
      - const: inck

  assigned-clocks:
    maxItems: 1

  assigned-clock-rates:
    items:
      - const: 37125000

  avdd-supply:
    description: Analog power supply (3.3 V).

  dvdd-supply:
    description: Digital core power supply (1.1 V).

  dovdd-supply:
    description: Digital I/O power supply (1.8 V).

  reset-gpios:
    description: Sensor reset (XCLR) GPIO.
    maxItems: 1

  simaai,ipi-enable-delay-ms:
    default: 0
    maximum: 5000
    description:
      Legacy downstream source-node delay consumed by the CSI-2 receiver in
      either timing mode. New device trees put
      simaai,ipi-controller-enable-delay-ms on the receiver node for an
      explicitly controller-mode-only delay.

  port:
    $ref: '#/$defs/port'

required:
  - compatible
  - reg
  - clocks
  - clock-names
  - avdd-supply
  - dvdd-supply
  - dovdd-supply
  - port

unevaluatedProperties: false

examples:
  - |
    i2c {
        #address-cells = <1>;
        #size-cells = <0>;

        camera@3d {
            compatible = "sony,imx568";
            reg = <0x3d>;
            clocks = <&imx568_clk>;
            clock-names = "inck";
            avdd-supply = <&imx568_avdd>;
            dvdd-supply = <&imx568_dvdd>;
            dovdd-supply = <&imx568_dovdd>;
            port {
                imx568_out: endpoint {
                    clock-lanes = <0>;
                    data-lanes = <1 2 3 4>;
                    link-frequencies = /bits/ 64 <594000000>;
                    remote-endpoint = <&csi_in>;
                };
            };
        };
    };
...
```

## Documentation/devicetree/bindings/misc/simaai,stu.yaml
```yaml
# SPDX-License-Identifier: (GPL-2.0-only OR BSD-2-Clause)
%YAML 1.2
---
$id: http://devicetree.org/schemas/misc/simaai,stu.yaml#
$schema: http://devicetree.org/meta-schemas/core.yaml#

title: SiMa.ai STU (Simple Translation Unit)

maintainers:
  - Nilesh Raghuvanshi <nilesh.r@sima.ai>

description: |
  Translates a 32-bit bus (device) address to a physical one using eight fixed
  512 MB windows. Window 0 is a driver-managed identity map.

properties:
  compatible:
    const: simaai,stu

  reg:
    maxItems: 1

  simaai,stu-gfill-value:
    $ref: /schemas/types.yaml#/definitions/uint32
    description:
      Global fill value written to the STU GFILL register.

  memory-region:
    minItems: 1
    maxItems: 7
    description:
      Physical reserved regions to map, in order, each fills as many consecutive
      windows as it spans, skipping blocks already reachable.

  simaai,stu-bus-range:
    $ref: /schemas/types.yaml#/definitions/uint32-array
    minItems: 2
    maxItems: 2
    description:
      Inclusive bus window range [start, end] to fill

required:
  - compatible
  - reg
  - simaai,stu-gfill-value
  - memory-region
  - simaai,stu-bus-range

additionalProperties: false

examples:
  - |
    reserved-memory {
        #address-cells = <2>;
        #size-cells = <2>;

        cma_reserved: linux,cma {
            compatible = "shared-dma-pool";
            reusable;
            reg = <0x10 0x00000000 0x0 0x6fc00000>;
        };
    };

    stu@40d3000 {
        compatible = "simaai,stu";
        reg = <0x040d3000 0x420>;
        simaai,stu-gfill-value = <0x0>;
        memory-region = <&cma_reserved>;
        simaai,stu-bus-range = <0x80000000 0xffffffff>;
    };
```

## Documentation/devicetree/bindings/npu/simaai,mla-modalix.yaml
```yaml
# SPDX-License-Identifier: (GPL-2.0-only OR BSD-2-Clause)
%YAML 1.2
---
$id: http://devicetree.org/schemas/npu/simaai,mla-modalix.yaml#
$schema: http://devicetree.org/meta-schemas/core.yaml#

title: SiMa.ai Machine Learning Accelerator (MLA)

maintainers:
  - Vimal Nakum <vimal.nakum@sima.ai>

description:
  The Machine Learning Accelerator found on SiMa.ai Modalix SoCs. The MLA
  executes pre-compiled model binaries produced by the SiMa.ai model
  compiler; the driver exposes /dev/mla, an io_uring_cmd based interface
  used by the mla-rt / libMLArt.so userspace runtime.

  Hardware is strictly single-job-in-flight. Jobs are queued and
  dispatched by the driver, which programs the tile instruction and DMA
  descriptor blobs before each run and completes on a per-job interrupt.

properties:
  $nodename:
    pattern: '^mla@[0-9a-f]+$'

  compatible:
    enum:
      - simaai,mla-modalix

  reg:
    maxItems: 1
    description:
      The MLA AXI register window. Covers the tile, DMA and interrupt
      register banks the driver programs directly.

  interrupts:
    maxItems: 2

  interrupt-names:
    items:
      - const: ftl
      - const: non_ftl
    description: |
      ftl      - fatal interrupt. Raised on an unrecoverable hardware
                 error (for example a mosaic quadgroup timeout); the
                 driver decodes the fault status and enters recovery.
      non_ftl  - non-fatal interrupt. Carries normal job completion
                 (PROGDONE), and is the sole completion source.

  memory-region:
    maxItems: 1
    description: |
      DMS memory region carrying the label of its DMA heap. Supports
      legacy "carved-out" regions or reusable "simaai,mla-cma",
      "shared-dma-pool" regions described by
      reserved-memory/simaai,mla-cma.yaml.

  clocks:
    items:
      - description:
          Rate-controllable MLA PLL. Scaled at runtime via devfreq
          against the operating-points-v2 table.
      - description:
          MLA clock gate; enables the core and deasserts its reset.

  clock-names:
    items:
      - const: pll
      - const: gate

  operating-points-v2:
    maxItems: 1
    description: |
      Supported MLA core frequencies. Consumed through devfreq with the
      userspace governor; the initial rate is whatever the PLL reports
      at probe. OPPs carry opp-supported-hw, a bitmask matched against
      the boot PLL rate read at probe: bit 0 marks OPPs valid when the
      PLL boots at 600 MHz (100..600 MHz), bit 1 those valid when it
      boots at 1000 MHz (100..1000 MHz). Only matching OPPs are
      registered.

  simaai,reg-list:
    $ref: /schemas/types.yaml#/definitions/uint32-array
    minItems: 1
    maxItems: 64
    description:
      Physical addresses of the 32-bit registers exposed by the legacy
      /dev/simaai-mlamem READ_REG/WRITE_REG ioctls, used by versions of
      mla-rt that predate /dev/mla. Userspace addresses them by index
      into this list; 0xffffffff marks an unused index. Without it,
      /dev/simaai-mlamem is not created and /dev/mla is unaffected.

required:
  - compatible
  - reg
  - interrupts
  - interrupt-names
  - memory-region

additionalProperties: false

examples:
  - |
    #include <dt-bindings/clock/simaai,clkc-prc.h>
    #include <dt-bindings/interrupt-controller/arm-gic.h>

    soc {
        #address-cells = <2>;
        #size-cells = <2>;

        mla@5000000 {
            compatible = "simaai,mla-modalix";
            reg = <0x0 0x5000000 0x0 0xfe00>;
            interrupts = <GIC_SPI 86 IRQ_TYPE_LEVEL_HIGH>,
                         <GIC_SPI 87 IRQ_TYPE_LEVEL_HIGH>;
            interrupt-names = "ftl", "non_ftl";
            memory-region = <&dms0_reserved>;
            clocks = <&clkc SIMAAI_PRC_CLK_MLA_PLL>,
                     <&clkc SIMAAI_PRC_CLK_MLA_GATE>;
            clock-names = "pll", "gate";
            operating-points-v2 = <&mla_opp_table>;
            simaai,reg-list = <0x0ff00014 0x0ff00594 0xffffffff 0x0ff00528
                               0x0500f438 0x0500f638 0x0500f838 0x0500fa38>;
        };
    };
```

## Documentation/devicetree/bindings/phy/snps,dphy-rx.yaml
```yaml
# SPDX-License-Identifier: (GPL-2.0-only OR BSD-2-Clause)
%YAML 1.2
---
$id: http://devicetree.org/schemas/phy/snps,dphy-rx.yaml#
$schema: http://devicetree.org/meta-schemas/core.yaml#

title: Synopsys DesignWare MIPI D-PHY RX

maintainers:
  - Luis Oliveira <Luis.Oliveira@synopsys.com>

description: |
  Synopsys DesignWare MIPI D-PHY RX Controller. This PHY handles the
  physical layer for MIPI CSI-2 receivers.

properties:
  compatible:
    oneOf:
      - const: snps,dphy-rx
      - items:
          - const: simaai,modalix-dphy-rx
          - const: snps,dphy-rx

  reg:
    minItems: 2
    maxItems: 3
    items:
      - description: Primary D-PHY register bank
      - description: Glue/Wrapper logic register bank
      - description: Secondary D-PHY interface bank (required for 8-lane Gen3)

  reg-names:
    minItems: 2
    maxItems: 3
    items:
      - const: dphy
      - const: glue
      - const: dphy-ext

  "#phy-cells":
    const: 0

  snps,dphy-te-len:
    $ref: /schemas/types.yaml#/definitions/uint32
    description:
      Configuration value for the Tearing Effect (TE) length.
      Specific to the integration of the D-PHY in the SoC.

  snps,rx-hs-gain-mode:
    $ref: /schemas/types.yaml#/definitions/uint32
    enum: [0, 1, 2, 3]
    description:
      Force the HS receiver gain mode instead of the one the start-up machine
      derives from the hsfreqrange band (1 below 1.5 Gbps, 3 above), for a
      transmitter whose signal is too small for the band's setting. Gen3
      12-bit integration (simaai,modalix-dphy-rx) only.

  snps,rx-hs-eq-strength:
    $ref: /schemas/types.yaml#/definitions/uint32
    minimum: 0
    maximum: 7
    default: 7
    description:
      HS equalizer strength for every active data lane, from 0 (weakest) to
      7 (strongest). Gen3 12-bit integration (simaai,modalix-dphy-rx) only.

  snps,config-gpios:
    maxItems: 1
    description:
      GPIO used for configuration/reset logic in 8-lane configurations.
      (Mapped to the first GPIO index in the driver).

required:
  - compatible
  - reg
  - "#phy-cells"
  - snps,dphy-te-len

allOf:
  - if:
      not:
        properties:
          compatible:
            contains:
              const: simaai,modalix-dphy-rx
    then:
      properties:
        snps,rx-hs-gain-mode: false
        snps,rx-hs-eq-strength: false

additionalProperties: false

examples:
  - |
    phy@50000 {
        compatible = "snps,dphy-rx";
        reg = <0x50000 0x1000>,
              <0x51000 0x1000>;
        reg-names = "dphy", "glue";
        #phy-cells = <0>;
        snps,dphy-te-len = <0x100>;
    };

  - |
    /* Example for 8-lane Gen3 configuration */
    phy@60000 {
        compatible = "snps,dphy-rx";
        reg = <0x60000 0x1000>,
              <0x61000 0x1000>,
              <0x62000 0x1000>;
        reg-names = "dphy", "glue", "dphy-ext";
        #phy-cells = <0>;
        snps,dphy-te-len = <0x200>;
        snps,config-gpios = <&gpio1 5 0>;
    };
```
