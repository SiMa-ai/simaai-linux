## Documentation/devicetree/bindings/power/reset/simaai,modalix-poweroff.yaml
```yaml
# SPDX-License-Identifier: (GPL-2.0-only OR BSD-2-Clause)
%YAML 1.2
---
$id: http://devicetree.org/schemas/power/reset/simaai,modalix-poweroff.yaml#
$schema: http://devicetree.org/meta-schemas/core.yaml#

title: SiMa.ai Modalix power-off

maintainers:
  - Bharanidharan Ramalingam <bharanidharan.ramalingam@sima.ai>

description: |
  Power-off support for the SiMa.ai Modalix SoC. On shutdown the driver
  attempts, in order, whatever the board provides:

    1. a shutdown GPIO,
    2. a PMIC rail soft-off over PMBus/i2c,
    3. an HPI request to the secure processor.

  The HPI method needs no DT description and is registered unconditionally
  (it also keeps kernel_can_power_off() true). The GPIO and PMIC methods are
  optional and enabled by the properties below; they run in the sleepable
  POWER_OFF_PREPARE phase.

properties:
  compatible:
    const: simaai,modalix-poweroff

  poweroff-gpios:
    maxItems: 1
    description:
      GPIO asserted at power-off. The polarity flag selects the asserted
      level (e.g. GPIO_ACTIVE_HIGH drives the pin high on power-off).

  simaai,poweroff-i2c-bus:
    $ref: /schemas/types.yaml#/definitions/phandle
    description:
      Phandle to the i2c controller the board PMIC sits on. Referencing the
      controller (not the PMIC node) keeps power-off independent of the PMIC's
      own driver.

  simaai,poweroff-i2c-addr:
    $ref: /schemas/types.yaml#/definitions/uint32
    minimum: 0
    maximum: 0x7f
    description: i2c address of the PMIC.

  simaai,poweroff-i2c-page:
    $ref: /schemas/types.yaml#/definitions/uint32
    minimum: 0
    maximum: 0xff
    default: 0
    description:
      PMBus PAGE selecting the rail to soft-off (e.g. the buck index).

required:
  - compatible

dependencies:
  simaai,poweroff-i2c-bus: [ 'simaai,poweroff-i2c-addr' ]
  simaai,poweroff-i2c-addr: [ 'simaai,poweroff-i2c-bus' ]
  simaai,poweroff-i2c-page: [ 'simaai,poweroff-i2c-bus' ]

additionalProperties: false

examples:
  - |
    #include <dt-bindings/gpio/gpio.h>

    poweroff {
        compatible = "simaai,modalix-poweroff";
        poweroff-gpios = <&port5 0 GPIO_ACTIVE_HIGH>;
        simaai,poweroff-i2c-bus = <&i2c23>;
        simaai,poweroff-i2c-addr = <0x4f>;
        simaai,poweroff-i2c-page = <0>;
    };

  - |
    /* non-SoM board: HPI only, no optional properties */
    poweroff {
        compatible = "simaai,modalix-poweroff";
    };
```

## Documentation/devicetree/bindings/reserved-memory/carved-out.yaml
```yaml
# SPDX-License-Identifier: GPL-2.0-only OR BSD-2-Clause
%YAML 1.2
---
$id: http://devicetree.org/schemas/reserved-memory/carved-out.yaml#
$schema: http://devicetree.org/meta-schemas/core.yaml#

title: Carved-out Memory Region

description: |
  Specifies that the reserved memory region has been carved out of the
  main memory allocator, and is intended to be used by the OS as a
  dedicated memory allocator.

maintainers:
  - Maxime Ripard <mripard@kernel.org>

properties:
  compatible:
    const: carved-out

  reg:
    description: region of memory that is carved out.

allOf:
  - $ref: reserved-memory.yaml
  - not:
      required:
        - reusable
  - not:
      required:
        - no-map

required:
  - compatible
  - reg

unevaluatedProperties: false

examples:
  - |
    reserved-memory {
        #address-cells = <1>;
        #size-cells = <1>;

        memory@12340000 {
            compatible = "carved-out";
            reg = <0x12340000 0x00800000>;
        };
    };
```

## Documentation/devicetree/bindings/reserved-memory/simaai,mla-cma.yaml
```yaml
# SPDX-License-Identifier: (GPL-2.0-only OR BSD-2-Clause)
%YAML 1.2
---
$id: http://devicetree.org/schemas/reserved-memory/simaai,mla-cma.yaml#
$schema: http://devicetree.org/meta-schemas/core.yaml#

title: SiMa MLA reusable DMA memory

maintainers:
  - Vimal Nakum <vimal.nakum@sima.ai>

description: |
  MLA-accessible System RAM made available to Linux movable allocations while
  not held by a DMA buffer. The region is a dedicated, non-default CMA pool.
  Userspace and the MLA driver share the CMA allocator backing its named
  DMA-BUF heap; no carveout allocator may manage the same interval. The label preserves the
  established userspace heap name independently of physical placement.

  The node NAME must also keep the established "dms@" prefix, not only the
  label: the mla-rt runtime enumerates /proc/device-tree/reserved-memory and
  matches children on that name prefix, refusing to start when it finds no
  such node.

select:
  properties:
    compatible:
      contains:
        const: simaai,mla-cma
  required:
    - compatible

allOf:
  - $ref: reserved-memory.yaml

properties:
  compatible:
    items:
      - const: simaai,mla-cma
      - const: shared-dma-pool

  reg:
    maxItems: 1

  label:
    const: simaai,dms

  reusable: true

  no-map: false

  linux,cma-default: false

  linux,dma-default: false

required:
  - compatible
  - reg
  - label
  - reusable

unevaluatedProperties: false

examples:
  - |
    reserved-memory {
        #address-cells = <2>;
        #size-cells = <2>;
        ranges;

        dms@1300000000 {
            compatible = "simaai,mla-cma", "shared-dma-pool";
            label = "simaai,dms";
            reusable;
            reg = <0x13 0x00000000 0x4 0x00000000>;
        };
    };
```

## drivers/accel/simaaimla/Kconfig
```kconfig
# SPDX-License-Identifier: GPL-2.0
config SIMAAI_MLA
	tristate "SiMa.ai Modalix MLA (Machine Learning Accelerator) driver"
	depends on ARM64 || COMPILE_TEST
	depends on IO_URING
	depends on DMA_SHARED_BUFFER
	depends on DMABUF_HEAPS
	select DMA_CMA
	help
	  Support for the SiMa.ai Modalix Machine Learning Accelerator.
	  Exposes /dev/mla, an io_uring_cmd based interface for loading and
	  executing compiled MLA models. Userspace runtime is mla-rt /
	  libMLArt.so from the sibling mla_rt repository.

	  DRAM buffers prefer the shared simaai,mla fallback DMA heap when
	  available, otherwise the heap over the node's memory-region.
	  Enable DMABUF_HEAPS_CARVEOUT for the legacy reserved pool, or
	  DMABUF_HEAPS_CMA for reusable DMS and the shared fallback heap.

	  To compile as a module, choose M here: the module will be called
	  mla.
```

## drivers/media/al5r/Kconfig
```kconfig
    config ALLEGRO_CODEC_DRIVER
        tristate "Allegro IP driver"
        depends on HAS_DMA
        depends on HAS_IOMEM
        help
	  Say Y for enabling the hardware codec driver

          To compile this support as a module, choose M here:
          The module will be called allegro_encoder.
          If unsure, say N.

    config ALLEGRO_CODEC_KUNIT
        bool "KUnit tests for the AL5R command arbiter"
        depends on ALLEGRO_CODEC_DRIVER && KUNIT=y
        default n
        help
          Unit tests for the command-arbiter recovery path, covering the
          retire-then-reuse interleaving in which a command retires before
          its timeout recovery runs and the slot is reused meanwhile.
          Built in when selected, but only run when the kernel is booted
          with simaai_vidip_kunit; otherwise every case reports as skipped.
          Needs no codec hardware. If unsure, say N.
```

## drivers/media/i2c/simaai/Kconfig
```kconfig
# SPDX-License-Identifier: GPL-2.0
#
# SiMa.ai authored drivers

config VIDEO_INTROSPECT_MIPI_GEN
	tristate "Introspect Technology SV3C-DPTX MIPI generator stub support"
	depends on I2C && VIDEO_DEV
	select VIDEO_V4L2_SUBDEV_API
	select MEDIA_CONTROLLER
	select V4L2_FWNODE
	help
	  This is a Video4Linux2 placeholder subdev driver for an
	  Introspect Technology SV3C-DPTX MIPI D-PHY generator, used in
	  place of a real camera sensor for CSI-2 receiver bring-up and
	  validation. It performs no I2C/CCI register access, since the
	  generator has no such interface.

	  Not included in any shipped defconfig - enable explicitly (as
	  a module, =m) only when generator-based bring-up/testing is
	  actually needed.

	  To compile this driver as a module, choose M here: the
	  module will be called introspect_mipi_generator.
```

## drivers/phy/dw/Kconfig
```kconfig
# SPDX-License-Identifier: GPL-2.0

comment "Synopsys mipi dphy drivers"

config DWC_MIPI_DPHY_GEN3
	tristate "DesignWare platform support using a Gen3 D-PHY"
	depends on VIDEO_DWC_MIPI_CSI2
	select GENERIC_PHY
	help
	 Synopsys MIPI D-PHY Generation 3 reference driver. This driver supports
	 all Generation 3 D-PHYs. Choose Y or M if you have a platform with this
	 block.

	  If unsure, say N.

if DWC_MIPI_DPHY_GEN3

config DWC_MIPI_TC_DPHY_GEN3
	bool "Platform support using a Synopsys Test Chip"
	help
	 Synopsys Test Chip is for prototyping purposes. This enables extra
	 features that exist only in prototyping and/or for debug purposes.

	  If unsure, say N.

endif # DWC_MIPI_DPHY_GEN3
```
