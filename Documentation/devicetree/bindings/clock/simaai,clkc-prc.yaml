## Documentation/devicetree/bindings/clock/simaai,clkc-prc.yaml
```yaml
# SPDX-License-Identifier: (GPL-2.0-only OR BSD-2-Clause)
%YAML 1.2
---
$id: http://devicetree.org/schemas/clock/simaai,prc-modalix-clkc.yaml#
$schema: http://devicetree.org/meta-schemas/core.yaml#

title: SiMa.ai PRC Clock Controller

maintainers:
  - Bharanidharan Ramalingam <bharanidharan.ramalingam@sima.ai>

description: |
  The SiMa.ai PRC clock controller manages PLLs and gate clocks for
  on-chip subsystems MLA (Machine Learning Accelerator) and ISP.
  Each PLL is derived from the board reference oscillator, gate clocks select
  a PLL as parent.

  Please refer to clock-bindings.txt for common clock controller binding usage.

properties:
  compatible:
    const: simaai,clkc-prc

  reg:
    maxItems: 1

  clocks:
    maxItems: 1
    description: Reference oscillator input to all PLLs.

  clock-names:
    maxItems: 1

  "#clock-cells":
    const: 1
    description: |
      Index of the clock to consume. Use the constants from
      <dt-bindings/clock/simaai,clkc-prc.h>:

      Index  Define                    Description
        0    SIMAAI_PRC_CLK_MLA_PLL   MLA PLL
        1    SIMAAI_PRC_CLK_ISP_PLL   ISP PLL
        2    SIMAAI_PRC_CLK_MLA_GATE  MLA clock gate
        3    SIMAAI_PRC_CLK_ISP_GATE  ISP clock gate

  simaai,ignore-unused:
    $ref: /schemas/types.yaml#/definitions/uint32
    description:
      Bitmask of clock indices that must remain enabled even when no consumer
      claims them (CLK_IGNORE_UNUSED). Bit i corresponds to clock index i.

required:
  - compatible
  - reg
  - clocks
  - "#clock-cells"

additionalProperties: false

examples:
  - |
    #include <dt-bindings/clock/simaai,clkc-prc.h>

    clock-controller@ff00000 {
      compatible = "simaai,clkc-prc";
      reg = <0x0 0x0ff00000 0x0 0x758>;
      clocks = <&ref_osc>;
      simaai,ignore-unused = <0xf>;
      #clock-cells = <1>;
    };
```

## Documentation/devicetree/bindings/mailbox/simaai,hpi.yaml
```yaml
# SPDX-License-Identifier: (GPL-2.0-only OR BSD-2-Clause)
%YAML 1.2
---
$id: http://devicetree.org/schemas/mailbox/simaai,hpi.yaml#
$schema: http://devicetree.org/meta-schemas/core.yaml#

title: SiMa.ai HPI mailbox controller

maintainers:
  - Yurii Konovalenko <yurii.konovalenko@sima.ai>
  - Bharanidharan Ramalingam <bharanidharan.ramalingam@sima.ai>

description:
  Host Processor Interface (HPI) mailbox on SiMa.ai SoCs, providing doorbell
  message passing between the A65 host and the ARC core.

properties:
  compatible:
    const: simaai,hpi-1.0

  reg:
    maxItems: 1

  interrupts:
    maxItems: 1

  "#mbox-cells":
    const: 1

required:
  - compatible
  - reg
  - interrupts
  - "#mbox-cells"

additionalProperties: false

examples:
  - |
    #include <dt-bindings/interrupt-controller/arm-gic.h>
    #include <dt-bindings/interrupt-controller/irq.h>

    mailbox@f0f1000 {
        compatible = "simaai,hpi-1.0";
        reg = <0x0f0f1000 0x1000>;
        interrupt-parent = <&gic>;
        interrupts = <GIC_SPI 0 IRQ_TYPE_LEVEL_HIGH>;
        #mbox-cells = <1>;
    };
```

## Documentation/devicetree/bindings/mailbox/simaai,modalix-hpi-client.yaml
```yaml
# SPDX-License-Identifier: (GPL-2.0-only OR BSD-2-Clause)
%YAML 1.2
---
$id: http://devicetree.org/schemas/mailbox/simaai,modalix-hpi-client.yaml#
$schema: http://devicetree.org/meta-schemas/core.yaml#

title: SiMa.ai HPI mailbox client

maintainers:
  - Bharanidharan Ramalingam <bharanidharan.ramalingam@sima.ai>

description:
  Consumer of the SiMa.ai HPI mailbox. Exposes /dev/simaai-hpi and the shared
  DDR used to exchange payloads with the tRoot.

properties:
  compatible:
    const: simaai,modalix-hpi-client

  mboxes:
    maxItems: 1
    description: HPI mailbox channel.

  simaai,fixed-shmem:
    $ref: /schemas/types.yaml#/definitions/uint64-array
    items:
      - description: fixed shared-DDR base address
      - description: fixed shared-DDR size
    description:
      Optional fallback for an old tRoot without the dynamic SHMEM_MAP
      handshake. Omit where the dynamic path is always used.

required:
  - compatible
  - mboxes

additionalProperties: false

examples:
  - |
    mailbox-client {
        compatible = "simaai,modalix-hpi-client";
        mboxes = <&hpi 0>;
        simaai,fixed-shmem = /bits/ 64 <0x1207500000 0x2200000>;
    };
```

## Documentation/devicetree/bindings/media/i2c/econ,imx568-gmsl.yaml
```yaml
# SPDX-License-Identifier: (GPL-2.0 OR BSD-2-Clause)
%YAML 1.2
---
$id: http://devicetree.org/schemas/media/i2c/econ,imx568-gmsl.yaml#
$schema: http://devicetree.org/meta-schemas/core.yaml#

title: e-con Systems IMX568 GMSL camera module

maintainers:
  - Nileshkumar Raghuvanshi <nileshkumar.raghuvanshi@gmail.com>

description: |-
  The e-con Systems camera module is built around the Sony IMX568 1/1.8-inch
  global-shutter CMOS image sensor paired with an on-board MCU/ISP. The module
  is connected over a GMSL serializer/deserializer link (MAX9295A serializer and
  MAX96716A deserializer) and presents a MIPI CSI-2 output to the host. The MCU
  is controlled over I2C and its firmware is loaded from the rootfs at probe
  time.

allOf:
  - $ref: /schemas/media/video-interface-devices.yaml#

properties:
  compatible:
    const: econ,imx568-gmsl

  reg:
    maxItems: 1

  clocks:
    maxItems: 1

  clock-names:
    items:
      - const: xclk

  VANA-supply:
    description: Analog (3.3V) supply.

  VDIG-supply:
    description: Digital core (1.1V) supply.

  VDDL-supply:
    description: Interface (1.8V) supply.

  reset-gpios:
    description: Reference to the GPIO connected to the MCU reset pin.
    maxItems: 1

  boot-gpios:
    description: Reference to the GPIO connected to the MCU boot pin.
    maxItems: 1

  cam_fw_name:
    $ref: /schemas/types.yaml#/definitions/string
    description:
      Name of the MCU firmware binary to request from the rootfs at probe time.

  camera_mipi_lanes:
    $ref: /schemas/types.yaml#/definitions/uint32
    enum: [2, 4]
    description: Number of MIPI CSI-2 data lanes used between the module and host.

  port:
    $ref: /schemas/graph.yaml#/$defs/port-base
    additionalProperties: false
    description: MIPI CSI-2 source port.

    properties:
      endpoint:
        $ref: /schemas/media/video-interfaces.yaml#
        unevaluatedProperties: false

        properties:
          data-lanes:
            minItems: 2
            maxItems: 4

          link-frequencies: true
          clock-lanes: true
          clock-continuous: true
          remote-endpoint: true

        required:
          - data-lanes
          - link-frequencies

required:
  - compatible
  - reg
  - clocks
  - port

unevaluatedProperties: false

examples:
  - |
    #include <dt-bindings/gpio/gpio.h>

    i2c {
        #address-cells = <1>;
        #size-cells = <0>;

        camera@42 {
            compatible = "econ,imx568-gmsl";
            reg = <0x42>;
            clocks = <&imx568_clk>;
            clock-names = "xclk";
            VANA-supply = <&imx568_vana>;
            VDIG-supply = <&imx568_vdig>;
            VDDL-supply = <&imx568_vddl>;
            camera_mipi_lanes = <2>;
            cam_fw_name = "imx568_cam_fw_gmsl.bin";

            port {
                imx568_out: endpoint {
                    clock-lanes = <0>;
                    data-lanes = <1 2>;
                    link-frequencies = /bits/ 64 <594000000>;
                    remote-endpoint = <&csi_in>;
                    clock-continuous;
                };
            };
        };
    };
...
```

## Documentation/devicetree/bindings/media/i2c/metoak-simor.yaml
```yaml
# SPDX-License-Identifier: (GPL-2.0-only OR BSD-2-Clause)
# Copyright (C) 2024 <vendor>
%YAML 1.2
---
$id: http://devicetree.org/schemas/media/i2c/metoak-simor.yaml#
$schema: http://devicetree.org/meta-schemas/core.yaml#

title: SIMOR Depth Sensor

maintainers:
  - Sagar Kontam <sagar.kontam@sima.ai>

description: |
  The SIMOR depth sensor is a MIPI CSI-2 depth-sensing device connected
  over I2C for control. It outputs depth image data via a MIPI CSI-2
  interface using configurable data and clock lanes.

properties:
  compatible:
    const: Metoak,simor

  reg:
    maxItems: 1
    description: I2C device address of the depth sensor.

  port:
    $ref: /schemas/graph.yaml#/$defs/port-base
    description: |
      Video output port. The sensor has a single output port (port@1)
      connected to a MIPI CSI-2 receiver.

    properties:
      reg:
        const: 1

      endpoint:
        $ref: /schemas/media/video-interfaces.yaml#
        unevaluatedProperties: false

        properties:
          clock-lanes:
            description: MIPI CSI-2 clock lane index.
            items:
              - const: 0

          data-lanes:
            description: |
              List of physical MIPI CSI-2 data lanes used. The sensor
              supports 2-lane operation.
            minItems: 1
            maxItems: 2

          link-frequencies:
            description: |
              Allowed MIPI CSI-2 link frequencies in Hz. Must be
              specified as a 64-bit value.
            maxItems: 1

          clock-continuous:
            description: |
              Indicates the sensor outputs a continuous clock on the
              MIPI CSI-2 clock lane.

          remote-endpoint:
            description: Reference to the CSI-2 receiver endpoint.

        required:
          - clock-lanes
          - data-lanes
          - link-frequencies
          - remote-endpoint

    required:
      - reg
      - endpoint

    additionalProperties: false

required:
  - compatible
  - reg
  - port

additionalProperties: false

examples:
  - |
    i2c {
        #address-cells = <1>;
        #size-cells = <0>;

        simor: simor@66 {
            compatible = "Metoak,simor";
            reg = <0x66>;

            port@1 {
                reg = <1>;
                cam20out: endpoint@0 {
                    clock-lanes = <0>;
                    data-lanes = <1 2>;
                    link-frequencies = /bits/ 64 <540000000>;
                    remote-endpoint = <&csi20in>;
                    clock-continuous;
                };
            };
        };
    };
```

## Documentation/devicetree/bindings/media/i2c/metoak-xc9080.yaml
```yaml
# SPDX-License-Identifier: (GPL-2.0-only OR BSD-2-Clause)
# Copyright (C) 2024 <vendor>
%YAML 1.2
---
$id: http://devicetree.org/schemas/media/i2c/metoak-xc9080.yaml#
$schema: http://devicetree.org/meta-schemas/core.yaml#

title: XC9080 MIPI CSI-2 Image Sensor

maintainers:
  - Sagar Kontam <sagar.kontam@sima.ai>

description: |
  The XC9080 is a MIPI CSI-2 image sensor connected over I2C for control.
  It outputs VYUY image data via a MIPI CSI-2 interface with configurable
  data and clock lanes.

properties:
  compatible:
    const: Metoak,xc9080

  reg:
    maxItems: 1
    description: I2C device address of the sensor.

  startup-delay-ms:
    description: |
      Delay in milliseconds after power-up before the sensor is ready
      to accept commands.
    default: 0

  reset-gpios:
    maxItems: 1
    description: |
      Reference to the GPIO connected to the RESET pin. The GPIO is
      asserted (active-low) to hold the sensor in reset.

  port:
    $ref: /schemas/graph.yaml#/$defs/port-base
    description: |
      Video output port. The sensor has a single output port (port@1)
      connected to a MIPI CSI-2 receiver.

    properties:
      reg:
        const: 1

      endpoint:
        $ref: /schemas/media/video-interfaces.yaml#
        unevaluatedProperties: false

        properties:
          clock-lanes:
            description: MIPI CSI-2 clock lane index.
            items:
              - const: 0

          data-lanes:
            description: |
              List of physical MIPI CSI-2 data lanes used. The sensor
              supports 2-lane operation.
            minItems: 1
            maxItems: 2

          link-frequencies:
            description: |
              Allowed MIPI CSI-2 link frequencies in Hz. Must be
              specified as a 64-bit value.
            maxItems: 1

          clock-continuous:
            description: |
              Indicates the sensor outputs a continuous clock on the
              MIPI CSI-2 clock lane.

          remote-endpoint:
            description: Reference to the CSI-2 receiver endpoint.

        required:
          - clock-lanes
          - data-lanes
          - link-frequencies
          - remote-endpoint

    required:
      - reg
      - endpoint

    additionalProperties: false

required:
  - compatible
  - reg
  - port

additionalProperties: false

examples:
  - |
    #include <dt-bindings/gpio/gpio.h>

    i2c {
        #address-cells = <1>;
        #size-cells = <0>;

        xc9080: xc9080@1b {
            compatible = "Metoak,xc9080";
            reg = <0x1b>;

            startup-delay-ms = <0>;
            reset-gpios = <&port5 6 GPIO_ACTIVE_LOW>;

            port@1 {
                reg = <1>;
                cam10out: endpoint@0 {
                    clock-lanes = <0>;
                    data-lanes = <1 2>;
                    link-frequencies = /bits/ 64 <480000000>;
                    remote-endpoint = <&csi10in>;
                    clock-continuous;
                };
            };
        };
    };
```
