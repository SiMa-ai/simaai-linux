## Documentation/devicetree/bindings/media/simaai,v4l2-vdma.yaml
```yaml
# SPDX-License-Identifier: (GPL-2.0-only OR BSD-2-Clause)
%YAML 1.2
---
$id: http://devicetree.org/schemas/media/simaai,v4l2-vdma.yaml#
$schema: http://devicetree.org/meta-schemas/core.yaml#

title: SiMa.ai V4L2 Vision DMA

maintainers:
  - Yurii Konovalenko <yurii.konovalenko@sima.ai>

description: |
  The SiMa.ai V4L2 VDMA driver acts as a bridge entity in the media graph.
  It manages DMA channels to write video data to memory. It connects to a
  upstream video source (CSI-RX) and a downstream video interface.

properties:
  compatible:
    const: simaai,v4l2-vdma

  id:
    $ref: /schemas/types.yaml#/definitions/uint32
    description: Instance identifier for the VDMA block.

  dmas:
    minItems: 1
    maxItems: 4
    description: List of DMA channel specs for the video channels.

  dma-names:
    minItems: 1
    maxItems: 4
    items:
      enum:
        - channel-0
        - channel-1
        - channel-2
        - channel-3

  ports:
    $ref: /schemas/graph.yaml#/properties/ports

    properties:
      port@0:
        $ref: /schemas/graph.yaml#/properties/port
        description: Input for Channel 0 (connected to Sensor/CSI)

      port@1:
        $ref: /schemas/graph.yaml#/properties/port
        description: Input for Channel 1 (connected to Sensor/CSI)

      port@2:
        $ref: /schemas/graph.yaml#/properties/port
        description: Input for Channel 2 (connected to Sensor/CSI)

      port@3:
        $ref: /schemas/graph.yaml#/properties/port
        description: Input for Channel 3 (connected to Sensor/CSI)

      # Ports 4-7 are technically the source pads in the driver structure,
      # usually represented as output ports in DT to connect to the video node.
      port@4:
        $ref: /schemas/graph.yaml#/properties/port
        description: Output for Channel 0 (connected to csi2-video)

      port@5:
        $ref: /schemas/graph.yaml#/properties/port
        description: Output for Channel 1 (connected to csi2-video)

      port@6:
        $ref: /schemas/graph.yaml#/properties/port
        description: Output for Channel 2 (connected to csi2-video)

      port@7:
        $ref: /schemas/graph.yaml#/properties/port
        description: Output for Channel 3 (connected to csi2-video)

    required:
      - port@0

required:
  - compatible
  - id
  - dmas
  - dma-names
  - ports

additionalProperties: false

examples:
  - |
    #include <dt-bindings/dma/simaai-dma.h> /* Hypothetical header */

    v4l2_vdma: vdma {
        compatible = "simaai,v4l2-vdma";
        id = <0>;

        dmas = <&axi_dma 0>, <&axi_dma 1>;
        dma-names = "channel-0", "channel-1";

        ports {
            #address-cells = <1>;
            #size-cells = <0>;

            /* Inputs from CSI RX */
            port@0 {
                reg = <0>;
                vdma_in0: endpoint {
                    remote-endpoint = <&csi_rx_out0>;
                };
            };

            port@1 {
                reg = <1>;
                vdma_in1: endpoint {
                    remote-endpoint = <&csi_rx_out1>;
                };
            };

            /* Outputs to Video Interface */
            port@4 {
                reg = <4>;
                vdma_out0: endpoint {
                    remote-endpoint = <&csi2_vid_in0>;
                };
            };

            port@5 {
                reg = <5>;
                vdma_out1: endpoint {
                    remote-endpoint = <&csi2_vid_in1>;
                };
            };
        };
    };
```

## Documentation/devicetree/bindings/media/simaai,v4l2-video.yaml
```yaml
# SPDX-License-Identifier: (GPL-2.0-only OR BSD-2-Clause)
%YAML 1.2
---
$id: http://devicetree.org/schemas/media/ssimaai,v4l2-video.yaml#
$schema: http://devicetree.org/meta-schemas/core.yaml#

title: SiMa.ai CSI2 Video Capture Interface

maintainers:
  - Yurii Konovalenko <yurii.konovalenko@sima.ai>

description: |
  The SiMa.ai CSI2 Video module acts as the V4L2 master device. It aggregates
  streams from the VDMA engine, ISP and registers video device nodes (/dev/videoX)
  for userspace consumption.

properties:
  compatible:
    const: simaai,v4l2-video

  ports:
    $ref: /schemas/graph.yaml#/properties/ports

    properties:
      port@0:
        $ref: /schemas/graph.yaml#/properties/port
        description: Connection to VDMA Channel 0

        properties:
          endpoint:
            properties:
              label:
                $ref: /schemas/types.yaml#/definitions/string
                description: |
                  Optional label for the video node. If present, this string
                  is used to name the /dev/videoX device (e.g., "Front Camera").

      port@1:
        $ref: /schemas/graph.yaml#/properties/port
        description: Connection to VDMA Channel 1

        properties:
          endpoint:
            properties:
              label:
                $ref: /schemas/types.yaml#/definitions/string
                description: Optional label for the video node.

      port@2:
        $ref: /schemas/graph.yaml#/properties/port
        description: Connection to VDMA Channel 2

        properties:
          endpoint:
            properties:
              label:
                $ref: /schemas/types.yaml#/definitions/string
                description: Optional label for the video node.

      port@3:
        $ref: /schemas/graph.yaml#/properties/port
        description: Connection to VDMA Channel 3

        properties:
          endpoint:
            properties:
              label:
                $ref: /schemas/types.yaml#/definitions/string
                description: Optional label for the video node.

    required:
      - port@0

required:
  - compatible
  - ports

additionalProperties: false

examples:
  - |
    csi2_video {
        compatible = "simaai,v4l2-video";

        ports {
            #address-cells = <1>;
            #size-cells = <0>;

            port@0 {
                reg = <0>;
                csi2_vid_in0: endpoint {
                    remote-endpoint = <&vdma_out0>;
                    label = "front-cam";
                };
            };

            port@1 {
                reg = <1>;
                csi2_vid_in1: endpoint {
                    remote-endpoint = <&vdma_out1>;
                    label = "rear-cam";
                };
            };
        };
    };
```

## Documentation/devicetree/bindings/media/snps,dw-mipi-csi2-v150.yaml
```yaml
# SPDX-License-Identifier: (GPL-2.0-only OR BSD-2-Clause)
%YAML 1.2
---
$id: http://devicetree.org/schemas/media/snps,dw-mipi-csi2-v150.yaml#
$schema: http://devicetree.org/meta-schemas/core.yaml#

title: Synopsys DesignWare CSI-2 Host controller (csi2host)

maintainers:
  - Frank Li <Frank.Li at nxp.com>
  - Eugen Hristev <eugen.hristev at microchip.com>

description:
  CSI2HOST is used to receive image coming from an MIPI CSI-2 compatible
  camera. It will convert the incoming CSI-2 stream into a dedicated
  interface called the Synopsys IDI (Image Data Interface).
  This interface is a 32-bit SoC internal only, and can be assimilated
  with a CSI-2 interface.

properties:
  compatible:
    oneOf:
      - items:
          - enum:
              - fsl,imx93-mipi-csi2
          - const: snps,dw-mipi-csi2-v150
      - const: snps,dw-mipi-csi2-v150

  reg:
    items:
      - description: MIPI CSI-2 core register

  reg-names:
    items:
      - const: core

  clocks:
    maxItems: 2

  clock-names:
    items:
      - const: per
      - const: pixel

  phys:
    maxItems: 1
    description: MIPI D-PHY

  phy-names:
    items:
      - const: rx

  resets:
    maxItems: 1

  interrupts:
    maxItems: 1

  power-domains:
    maxItems: 1

  # SiMa.ai specific extensions: seed the IPI (Image Pixel Interface)
  # blanking timings and the default value of the IPI custom V4L2 controls.
  # All are optional; the driver falls back to its built-in defaults when a
  # property is absent. The active resolution is taken from the V4L2 format
  # and is intentionally not described here.
  simaai,bt-pixelclock:
    $ref: /schemas/types.yaml#/definitions/uint64
    description:
      MIPI clock in Hz used as the reference for converting the IPI
      horizontal blanking intervals (hsync, hbackporch, hfrontporch) to
      nanoseconds.

  simaai,bt-hsync:
    $ref: /schemas/types.yaml#/definitions/uint32
    description: IPI horizontal sync width, in pixels.

  simaai,bt-hbackporch:
    $ref: /schemas/types.yaml#/definitions/uint32
    description: IPI horizontal back porch, in pixels.

  simaai,bt-hfrontporch:
    $ref: /schemas/types.yaml#/definitions/uint32
    description: IPI horizontal front porch, in pixels.

  simaai,bt-vsync:
    $ref: /schemas/types.yaml#/definitions/uint32
    description: IPI vertical sync width, in lines.

  simaai,bt-vbackporch:
    $ref: /schemas/types.yaml#/definitions/uint32
    description: IPI vertical back porch, in lines.

  simaai,bt-vfrontporch:
    $ref: /schemas/types.yaml#/definitions/uint32
    description: IPI vertical front porch, in lines.

  simaai,ipi-controller-mode:
    $ref: /schemas/types.yaml#/definitions/uint32
    enum: [0, 1]
    default: 0
    description:
      Default value for the "IPI Controller Mode" V4L2 control. 1 selects
      controller timing mode, 0 (default) selects camera timing mode.

  simaai,ipi-emb-data-enable:
    $ref: /schemas/types.yaml#/definitions/uint32
    enum: [0, 1]
    default: 0
    description:
      Default value for the "IPI Embedded Data Enable" V4L2 control.

  ports:
    $ref: /schemas/graph.yaml#/properties/ports

    properties:
      port at 0:
        $ref: /schemas/graph.yaml#/$defs/port-base
        unevaluatedProperties: false
        description:
          Input port node, single endpoint describing the input port.

        properties:
          endpoint:
            $ref: video-interfaces.yaml#
            unevaluatedProperties: false
            description: Endpoint connected to input device

            properties:
              bus-type:
                const: 4

              data-lanes:
                minItems: 1
                maxItems: 4
                items:
                  maximum: 4

              clock-lanes:
                maxItems: 1

              remote-endpoint: true

      port at 1:
        $ref: /schemas/graph.yaml#/$defs/port-base
        unevaluatedProperties: false
        description:
          Output port node, single endpoint describing the output port.

        properties:
          endpoint:
            unevaluatedProperties: false
            $ref: video-interfaces.yaml#
            description: Endpoint connected to output device

            properties:
              bus-type:
                const: 4

              remote-endpoint: true

    required:
      - port at 0
      - port at 1

additionalProperties: false

required:
  - compatible
  - reg
  - reg-names
  - interrupts
  - ports

examples:
  - |
    csi at 3000 {
        compatible = "snps,dw-mipi-csi2-v150";
        reg = <0x03000 0x1000>;
        reg-names = "core";
        phys = <&mipi_dphy_rx 0>;
        phy-names = "rx";
        resets = <&dw_rst 1>;
        interrupts = <2>;

        ports {
            #address-cells = <1>;
            #size-cells = <0>;

            port at 0 {
                reg = <0>;

                endpoint {
                    bus-type = <4>; /* MIPI CSI2 D-PHY */
                    remote-endpoint = <&camera_1>;
                    data-lanes = <1 2>;
                    clock-lanes = <0>;
                };
            };

            port at 1 {
                reg = <1>;

                endpoint {
                    remote-endpoint = <&idi_receiver>;
                    bus-type = <4>;
                };
            };
        };
    };

...
```

## Documentation/devicetree/bindings/phy/snps,dphy-rx.yaml
```yaml
# SPDX-License-Identifier: (GPL-2.0-only OR BSD-2-Clause)
%YAML 1.2
---
$id: http://devicetree.org/schemas/phy/snps,dphy-rx.yaml#
$schema: http://devicetree.org/meta-schemas/core.yaml#

title: Synopsys DesignWare MIPI D-PHY RX

maintainers:
  - Luis Oliveira <Luis.Oliveira@synopsys.com>

description: |
  Synopsys DesignWare MIPI D-PHY RX Controller. This PHY handles the
  physical layer for MIPI CSI-2 receivers.

properties:
  compatible:
    const: snps,dphy-rx

  reg:
    minItems: 2
    maxItems: 3
    items:
      - description: Primary D-PHY register bank
      - description: Glue/Wrapper logic register bank
      - description: Secondary D-PHY interface bank (required for 8-lane Gen3)

  reg-names:
    minItems: 2
    maxItems: 3
    items:
      - const: dphy
      - const: glue
      - const: dphy-ext

  "#phy-cells":
    const: 0

  snps,dphy-te-len:
    $ref: /schemas/types.yaml#/definitions/uint32
    description:
      Configuration value for the Tearing Effect (TE) length.
      Specific to the integration of the D-PHY in the SoC.

  snps,config-gpios:
    maxItems: 1
    description:
      GPIO used for configuration/reset logic in 8-lane configurations.
      (Mapped to the first GPIO index in the driver).

required:
  - compatible
  - reg
  - "#phy-cells"
  - snps,dphy-te-len

additionalProperties: false

examples:
  - |
    phy@50000 {
        compatible = "snps,dphy-rx";
        reg = <0x50000 0x1000>,
              <0x51000 0x1000>;
        reg-names = "dphy", "glue";
        #phy-cells = <0>;
        snps,dphy-te-len = <0x100>;
    };

  - |
    /* Example for 8-lane Gen3 configuration */
    phy@60000 {
        compatible = "snps,dphy-rx";
        reg = <0x60000 0x1000>,
              <0x61000 0x1000>,
              <0x62000 0x1000>;
        reg-names = "dphy", "glue", "dphy-ext";
        #phy-cells = <0>;
        snps,dphy-te-len = <0x200>;
        snps,config-gpios = <&gpio1 5 0>;
    };
```

## drivers/media/platform/simaai/Kconfig
```kconfig
# SPDX-License-Identifier: GPL-2.0-only

# V4L drivers

comment "SiMa.ai media platform drivers"

config VIDEO_DWC_MIPI_CSI2
	tristate "DesignWare Cores MIPI CSI-2 receiver found on Modalix platform"
	depends on VIDEO_DEV
	select MEDIA_CONTROLLER
	select V4L2_FWNODE
	select VIDEO_V4L2_SUBDEV_API
	help
	  Video4Linux2 sub-device driver for the DesignWare Cores MIPI
	  CSI-2 receiver used on Modalix platform.

config SIMAAI_V4L2_VDMA
	tristate "SiMa.ai v4l2 vision DMA driver"
	depends on HAS_DMA
	select V4L2_FWNODE
	select VIDEO_V4L2_SUBDEV_API
	select VIDEOBUF2_DMA_CONTIG
	help
	  This driver supports the SiMa.ai Vision DMA (VDMA) controller.
	  It functions as a V4L2 subdevice bridge that manages DMA channels
	  to transfer video data from upstream CSI receivers into system
	  memory.

	  To compile this driver as a module, choose M here: the
	  module will be called simaai-v4l2-vdma.

config SIMAAI_V4L2_VIDEO
	tristate "SiMa.ai V4L2 video capture driver"
	depends on SIMAAI_V4L2_VDMA
	depends on VIDEO_DEV
	select MEDIA_CONTROLLER
	select V4L2_FWNODE
	select VIDEO_V4L2_SUBDEV_API
	help
	  This driver supports the SiMa.ai V4L2 Video Capture interface.
	  It acts as the V4L2 master device, aggregating streams from the
	  underlying VDMA engine and registering the standard /dev/videoX
	  nodes for userspace consumption.

	  To compile this driver as a module, choose M here: the
	  module will be called simaai-v4l2-video.
```

## drivers/misc/simaai-pcie-ep/Kconfig
```kconfig
# SPDX-License-Identifier: GPL-2.0-only
config SIMAAI_PCIE_EP
	tristate "SiMa.ai PCIe EP Device driver support"
	depends on ARCH_SIMAAI
	help
	  Enable support for SiMa.ai PCIe EP device driver support on SoC
```
