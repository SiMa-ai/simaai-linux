## Documentation/devicetree/bindings/clock/simaai,clkdiv-sio.yaml
```yaml
# SPDX-License-Identifier: (GPL-2.0-only OR BSD-2-Clause)
%YAML 1.2
---
$id: "http://devicetree.org/schemas/clock/simaai,clkdiv-sio.yaml#"
$schema: "http://devicetree.org/meta-schemas/core.yaml#"

title: Driver for the SiMa.ai SIO's clock divider

maintainers:
  - Yurii Konovalenko <yurii.konovalenko@sima.ai>

description: |
  Driver for the SiMa.ai SIO's clock divider.
  Please refer to clock-bindings.txt for common clock controller binding usage.

properties:
  compatible:
    enum:
      - simaai,clkdiv-sio
    description:  For SiMa.ai SIO clock divider and gate controller, should be "simaai,clkdiv-sio"

  reg:
    maxItems: 1

  "#clock-cells":
    const: 1
    description:
      See table below for valid peripheral clock numbers.
      Clock       Define          Peripheral
        0	  SIMAAI_SIO_DEV_SPI0      SPI 0
        1   SIMAAI_SIO_DEV_SPI1      SPI 1
        2   SIMAAI_SIO_DEV_I2C0      I2C 0
        3   SIMAAI_SIO_DEV_I2C1      I2C 1
        4   SIMAAI_SIO_DEV_I2C2      I2C 2
        5   SIMAAI_SIO_DEV_I2C3      I2C 3
        6   SIMAAI_SIO_DEV_UART0     UART 0
        7   SIMAAI_SIO_DEV_UART1     UART 1
        8   SIMAAI_SIO_DEV_UART2     UART 2
        9   SIMAAI_SIO_DEV_UART3     UART 3
  simaai,ignore-unused:
    type: object
    description:
      If present this serves as mask for the claocks that should be always on. Driver will add the
      CLK_IGNORE_UNUSED to the clocks causing clocks enebled during probe and never turned off,
      even if they are unused. Can be useful for some critical blocks, that should never be turned
      off, even if not used bu Linux, for example UARTs that are used by other remote coprocessors

required:
  - compatible
  - reg
  - "#clock-cells"

additionalProperties: false

examples:
  - |
    #include <dt-bindings/pinctrl/pinctrl-simaai-sio.h>
    // Clock provider
    sio00_clk: siodivclk@0x04000300 {
      compatible = "simaai,clkdiv-sio";
      reg = <0x0 0x04000300 0 0x28>;
      #clock-cells = <1>;
      clocks = <&sys_div4_clk>;
      simaai,ignore-unused = <0x3C0>;
    };

    // Clock consumer
    uart00: uart@0x04006000 {
      compatible = "snps,dw-apb-uart";
      reg = <0x0 0x04006000 0x0 0x100>;
      interrupts = <GIC_SPI 282 IRQ_TYPE_LEVEL_HIGH>;
      reg-io-width = <4>;
      reg-shift = <2>;
      clocks = <&sio00_clk SIMAAI_SIO_DEV_UART0>;
			assigned-clocks = <&sio0_clk SIMAAI_SIO_DEV_UART0>;
			assigned-clock-rates = <249000000>;
      resets = <&reset00 SIMAAI_SIO_DEV_UART0>;
      pinctrl-0 = <&pins_uart00_deafult>;
      pinctrl-names = "default";
      status = "disabled";
    };
```

## Documentation/devicetree/bindings/counter/dw-apb-timer-cnt.txt
```
Synopsys DesignWare APB timer counter

This driver exposes a simple incremental counter for the timer.

Required properties:
- compatible:		Must be "snps,dw-apb-timer-counter-2.12a".
- reg:			Must be set to the memory region of the timer.

Optional property:
- interrupts: 		Should contain the channel interrupt signals to handle
			channel overflow
- snps,channels:	Number of channels in the timer

Example:
			counter0: counter@704000 {
				compatible = "snps,dw-apb-timer-counter-2.12a";
				reg = <0x0 0x00704000 0x0 0x000000b0>;
				interrupt-parent = <&gic>;
				interrupts = <GIC_SPI 8 IRQ_TYPE_LEVEL_HIGH>,
					     <GIC_SPI 9 IRQ_TYPE_LEVEL_HIGH>,
					     <GIC_SPI 10 IRQ_TYPE_LEVEL_HIGH>,
					     <GIC_SPI 11 IRQ_TYPE_LEVEL_HIGH>;
				snps,channels = <0x4>;
				status = "okay";
			};
```

## Documentation/devicetree/bindings/mailbox/sima-mailbox.txt
```
SiMa.ai Mailbox Driver
======================

Required properties:
- compatible :	"sima,mailbox-1.0".
- reg : 	physical base address of the mailbox and length of
		memory mapped region.
- #mbox-cells:	Common mailbox binding property to identify the number
		of cells required for the mailbox specifier. Should be 1.

Optional properties:
- interrupts :		interrupt number. The interrupt specifier format
			depends on the interrupt controller parent.
- sima,mbox-sender :	mailbox direction. The hardware supports only one
			channel and can be either sender or receiver.

Example:
	mbox_tx: mailbox@5070020 {
		compatible = "sima,mailbox-1.0";
		reg = <0 0x05070020 0 0x10>;
		interrupts = <0 14 4>;
		#mbox-cells = <1>;
		sima,mbox-sender;
	};

	mbox_rx: mailbox@5070040 {
		compatible = "sima,mailbox-1.0";
		reg = <0 0x05070040 0 0x10>;
		interrupts = <0 15 4>;
		#mbox-cells = <1>;
	};

Mailbox client
===============
"mboxes" and the optional "mbox-names" (please see
Documentation/devicetree/bindings/mailbox/mailbox.txt for details). Each value
of the mboxes property should contain a phandle to the mailbox controller
device node and second argument is the channel index. It must be 0 (hardware
support only one channel).The equivalent "mbox-names" property value can be
used to give a name to the communication channel to be used by the client user.

Example:
	mclient0: mclient0@0 {
		compatible = "sima,mailbox-client";
		mbox-names = "tx", "rx";
		mboxes = <&mbox_tx 0>, <&mbox_rx 0>;
	};
```

## Documentation/devicetree/bindings/media/allegro_codec_debug_driver.txt
```
al5r:

al,devicename: specifies the /dev/X name the created device should have. default is that the /dev/X node isn't created

al,regs_min_addr: specifies the offset at which the registers of the ip start in the mapped region
The default is 0.

al,regs_min_addr_auto: Try to find what the offset of current IP is based on the knowledge of some of the IP we support.

al,mem_offset_reg: You should only use this property if your IP only supports a 4G range.
Specify the hardware IP range register address. You should ask where this register is in your IP.
(See Hardware IP documentation)

al5e, al5d:

al,devicename: specifies the /dev/X name the created device should have. default is /dev/allegroIP for al5e and /dev/allegroDecodeIP for al5d
al,mcu_ext_mem_size: specifies the size in bytes of the external memory of the mcu. default is MCU_SUBALLOCATOR_SIZE

all:

memory-region: a phandle that points to a reserved-memory node. The driver will use the reserved memory instead of using the CMA pools to allocate its memory. It will also configure the hw ip if needed so that the ip can access the allocated memory. (See https://xilinx-wiki.atlassian.net/wiki/spaces/A/pages/18841683/Linux+Reserved+Memory for more information)

Here is an al5d device tree example in action

			al5d@a0120000 {
				compatible = "al,al5d-1.2", "al,al5d";
				interrupt-parent = <0x4>;
				interrupts = <0x0 0x59 0x4>;
				reg = <0x0 0xa0120000 0x0 0x10000>;
        al,mcu_ext_mem_size = 2097152; // 2MB instead of 32MB because you determined that you specific usecase doesn't need more memory for example
			};

Here is an al5r device tree example in action:

			al5r@a0100000 {
				compatible = "al,al5r";
				interrupt-parent = <0x4>;
				interrupts = <0x0 0x59 0x4>;
				reg = <0x0 0xa0100000 0x0 0x10000>;
        al,regs_min_addr = <0x8000>; // Could also be 0 depending on your IP version, you can also use al,regs_min_addr_auto
        al,devicename = "allegroIP"; // Will create the /dev/allegroIP node and link it to the driver for you
			};

And another example using a reserved-memory node

  / {
    amba_pl@0 {
        al5r@a3c80000 {
            compatible = "al,al5r";
            reg = <0x0 0xa3c80000 0x0 0x80000>;
            al,regs_min_addr = <0x8000>;
            interrupts = <0x0 0x59 0x4>;
            interrupt-parent = <0x4>;
            memory-region = <&reserved_dma>;
            al,mem_offset_reg = <0x8050>; // only if your IP doesn't support more than 4G addresses
            al,devicename = "allegroIP";
        };
    };
};

/ {
    reserved-memory {
        #address-cells = <2>;
        #size-cells = <2>;
        ranges;

        reserved_dma: buffer@0 {
            compatible = "shared-dma-pool";
            no-map;
            reg = <0x48 0x0 0x1 0x0>;
        };
    };
};
```

## Documentation/devicetree/bindings/media/snps,dw-mipi-csi.txt
```
Synopsys DesignWare CSI-2 Host controller

Description
-----------

This HW block is used to receive image coming from an MIPI CSI-2 compatible
camera.

Required properties:
- compatible		: shall be "snps,dw-csi"
- reg			: physical base address and size of the device memory
			  mapped registers;
- interrupts		: DW CSI-2 Host interrupts
- phys			: List of one PHY specifier (as defined in
			  Documentation/devicetree/bindings/phy/phy-bindings.txt).
			  This PHY is a MIPI DPHY working in RX mode.
- resets		: Reference to a reset controller (optional)

The per-board settings:
 - port sub-node describing a single endpoint connected to the camera as
   described in video-interfaces.txt[1].

Example:

	csi2: csi2@3000 {
		compatible = "snps,dw-csi";
		#address-cells = <1>;
		#size-cells = <0>;
		reg = < 0x03000 0x7FF>;
		phys = <&mipi_dphy_rx>;
		resets = <&dw_rst 1>;
		interrupts = <2>;

		port@0 {
			reg = <0>;
			csi_ep1: endpoint {
				remote-endpoint = <&camera_1>;
				data-lanes = <1 2>;
			};
		};
	};
```

## Documentation/devicetree/bindings/media/snps,plat-csi.txt
```
Synopsys DesignWare CSI-2 Host Media Device

The Synopsys DesignWare CSI-2 Host subsystem comprises of multiple
sub-devices represented by separate device tree nodes. Currently this includes:
plat-csi, video-device, and dw-mipi-csi.

The sub-subdevices are defined as child nodes of the common 'camera' node which
also includes common properties of the whole subsystem not really specific to
any single sub-device.

Common 'camera' node
--------------------

Required properties:

- compatible: must be "snps,plat-csi", "simple-bus"

The 'camera' node must include at least one 'video-device' and one 'dw-mipi-csi'
child node.

'video-device' device nodes
-------------------

Required properties:

- compatible: "snps,video-device"
- dmas, dma-names: List of one DMA specifier and identifier string (as defined
 in Documentation/devicetree/bindings/dma/dma.txt) per port. Each port
 requires a DMA channel with the identifier string set to "port" followed by
 the port index.

Image sensor nodes
------------------

The sensor device nodes should be added to their control bus controller (e.g.
I2C0) nodes and linked to a port node in the dw-mipi-csi,using the common video
interfaces bindings, defined in video-interfaces.txt.

Example:

 i2c@0x02000 {
 compatible = "snps,designware-i2c";
 #address-cells = <1>;
 #size-cells = <0>;
 reg = <0x02000 0x100>;
 clock-frequency = <400000>;
 clocks = <&i2cclk>;
 interrupts =<0>;
 ov: camera@0x36 {
 compatible = "ovti,ov5647";
 reg = <0x36>;
 port {
 camera_1: endpoint {
 remote-endpoint = <&csi1_ep1>;
 clock-lanes = <0>;
 data-lanes = <1 2 >;
           };
 };
     };
 };

 camera {
 compatible = "snps,plat-csi", "simple-bus";
 #address-cells = <1>;
 #size-cells = <1>;
 ranges;
 video_device: video-device@0x10000 {
 compatible = "snps,video-device";
 dmas = <&axi_vdma_0 0>;
 dma-names = "vdma0";
 };

 csi2_1: csi2@0x03000 {
 compatible = "snps,dw-mipi-csi";
 #address-cells = <1>;
 #size-cells = <0>;
 reg = < 0x03000 0x7FF>;
 interrupts = <2>;
 data-lanes = <2>;
 output-type = <2>;

 phys = <&mipi_phy_ctrl1 0>;
 phy-names = "csi2-dphy";

 /*IPI Related Configurations*/
 ipi-mode = <0>;
 ipi-color-mode = <0>;
 ipi-auto-flush = <1>;
 virtual-channel = <0>;

 /* Camera MIPI CSI-2 (CSI1) */
 port@1 {
 reg = <1>;
 csi1_ep1: endpoint {
 remote-endpoint = <&camera_1>;
 data-lanes = <1 2>;
           };
 };
         };
 };
};

The dw-mipi-csi device binding is defined in snps,dw-mipi-csi.txt.
```

## Documentation/devicetree/bindings/media/snps,video-device.txt
```
Synopsys DesignWare CSI-2 Host video device

This driver handles all the video handling part of this platform.

Required properties:

- compatible: Must be "snps,video-device".

- dmas, dma-names: List of one DMA specifier and identifier string (as defined
  in Documentation/devicetree/bindings/dma/dma.txt) per port. Each port
  requires a DMA channel with the identifier string set to "port" followed by
  the port index.
```

## Documentation/devicetree/bindings/misc/simaai,stu.yaml
```yaml
# SPDX-License-Identifier: (GPL-2.0-only OR BSD-2-Clause)
%YAML 1.2
---
$id: "http://devicetree.org/schemas/misc/simaai,stu.yaml#"
$schema: "http://devicetree.org/meta-schemas/core.yaml#"

title: SiMa.ai STU(Simple Translation Unit) Driver

maintainers:
  - Nilesh Raghuvanshi <nilesh.r@sima.ai>

description: |
  The SiMai.ai Simple Translation Unit(STU) driver

properties:
  compatible:
    enum:
      - simaai,stu
    description: For SiMa.ai STU, should be "simaai,stu"

  reg:
    maxItems: 1

  simaai,stu-gfill-value:
	type: "integer"
    description:
      provides Global fill value for STU block

  simaai,stu-table:
	type: "array"
	description: Array of entries for programming each table entries. First value is table index and
		second value has to be result of the lookup.
	items:
		minItems: 1
		maxItems: 8
		type: "integer"

required:
  - compatible
  - reg
  - simaai,stu-gfill-value
  - simaai,stu-table

additionalProperties: false

examples:
  - |
    // STU driver instance for CVU
	evxx_stu: evxx_stu@0x040d3000 {
		compatible = "simaai,stu";
		reg = <0x0 0x040d3000 0 0x420>;
		simaai,stu-gfill-value = <0x0>;
		simaai,stu-table =	<0 0x0>,
							<2 0x82>,
							<4 0x90>;
	};

	// STU client
	simaai,evmem-manager {
		compatible = "simaai,memory-manager";
		memory-region = <&evmem_reserved>;
		simaai,target = <6>;\
		simaai,stu = <&evxx_stu>;
		status = "okay";
	}
```

## Documentation/devicetree/bindings/phy/snps,dphy-rx.txt
```
Synopsys DesignWare MIPI Rx D-PHY block details

Description
-----------

The Synopsys MIPI D-PHY controller supports MIPI-DPHY in receiver mode.
Please refer to phy-bindings.txt for more information.

Required properties:
- compatible		: Shall be "snps,dphy-rx".
- #phy-cells		: Must be 1.
- snps,dphy-frequency	: Output frequency of the D-PHY.
- snps,dphy-te-len	: Size of the communication interface (8 bits->8 or 12bits->12).
- reg			: Physical base address and size of the device memory mapped registers;

Example:

	mipi_dphy_rx1: dphy@d00003040 {
		compatible = "snps,dphy-rx";
		#phy-cells = <1>;
		snps,dphy-frequency = <300000>;
		snps,dphy-te-len = <12>;
		reg = < 0xd0003040 0x20
			0xd0008000 0x100
			0xd0009000 0x100>;
	};
```
