## Documentation/devicetree/bindings/pinctrl/simaai,pinctrl-nvs.yaml
```yaml
# SPDX-License-Identifier: (GPL-2.0-only OR BSD-2-Clause)
%YAML 1.2
---
$id: "http://devicetree.org/schemas/pinctrl/simaai,pinctrl-nvs.yaml#"
$schema: "http://devicetree.org/meta-schemas/core.yaml#"

title: Driver for the SiMa.ai NVS's Pin Control Device

maintainers:
  - Yurii Konovalenko <yurii.konovalenko@sima.ai>

description: |
  SiMa.ai NVS Pin Control Driver

properties:
  compatible:
    enum:
      - simaai,pinctrl-nvs-spi
      - simaai,pinctrl-nvs-sdemmc
    description:  Define for SiMa.ai NVS pin controller

  reg:
    items:
      - description: NVS control registers region

#PIN CONFIGURATION NODES
patternProperties:
  'pinmux$':
    oneOf:
      - $ref: "#/$defs/simaai-pin-conf"
      - patternProperties:
          ".*":
            $ref: "#/$defs/simaai-pin-conf"

'$defs':
  simaai-pin-conf:
    type: object
    description:
      Pinctrl node's client devices use subnodes for desired pin configuration.
      Client device subnodes use below standard properties.
    $ref: "#/$defs/simaai-pin-conf"

    properties:
      pins:
        description:
          List of pins affected by the properties specified in this subnode.
        items:
          - enum: [ SPI0_D0, SPI0_D1, SPI0_D2, SPI0_D3, SPI0_D4, SPI0_D5, SPI0_D6, SPI0_D7,
                    SPI0_DMS, SPI0_SCLK_N, SPI0_SCLK_P, SPI0_SS_IN, SPI0_SS0, SPI0_SS1, SPI0_SS2, SPI0_SS3,
                    SPI1_D0, SPI1_D1, SPI1_D2, SPI1_D3, SPI1_D4, SPI1_D5, SPI1_D6, SPI1_D7,
                    SPI1_DMS, SPI1_SCLK_N, SPI1_SCLK_P, SPI1_SS_IN, SPI1_SS0, SPI1_SS1, SPI1_SS2, SPI1_SS3,
                    EMMC_D0, EMMC_D1, EMMC_D2, EMMC_D3, EMMC_D4, EMMC_D5, EMMC_D6, EMMC_D7,
                    EMMC_CMD, EMMC_CLK, EMMC_RST,
                    SDIO_D0, SDIO_D1, SDIO_D2, SDIO_D3,
                    SDIO_CMD, SDIO_CLK, SDIO_WP, SDIO_DET, SDIO_VSEL ]
        minItems: 1
        maxItems: 32
      pinfroups:
        description:
          List of pin groups affected by the properties specified in this subnode.
        items:
          - enum: [ spi0_group, spi1_group, emmc_group, sdio_group ]
      drive-strength:
        enum: [0, 1, 2, 3, 4, 5, 6, 7, 8, 9, 10, 11, 12, 13, 14, 15]
        default: 0
        description:
          Selects the drive strength for the specified pins, in mA.

      bias-pull-down: true

      bias-pull-up: true

      slew-rate: true

      input-enable: true

      output-enable: true

      simaai,retention:
        description: enable retention.
        type: boolean

      simaai,hysteresys:
        description: enable hysteresis.
        type: boolean

    required:
      oneOf:
        - pins
        - groups

    additionalProperties: false

allOf:
  - $ref: "pinctrl.yaml#"

required:
  - compatible
  - reg

additionalProperties: false

examples:
  - |
    #include <dt-bindings/pinctrl/pinctrl-simaai-sio.h>
    // Pin configuration provider
    nvs_pinmux_spi: pinmux@0x0408c000 {
      compatible = "simaai,pinctrl-nvs-spi";
      reg = <0x0 0x0408c000 0 0x130>;

      pins_nvs_spi0_deafult: pins_nvs_spi0 {
        nvs_spi0_data_pins {
          pins = "SPI0_D0", "SPI0_D1", "SPI0_D2", "SPI0_D3",
                "SPI0_D4", "SPI0_D5", "SPI0_D6", "SPI0_D7";
          input-enable;
          output-enable;
          drive-strength = <7>;
        };
        nvs_spi0_clk_pins {
          pins = "SPI0_SCLK_N", "SPI0_SCLK_P";
          output-enable;
          drive-strength = <7>;
        };
        nvs_spi0_ss_pins {
          pins = "SPI0_SS0", "SPI0_SS1", "SPI0_SS2", "SPI0_SS3";
          output-enable;
          drive-strength = <7>;
        };
        nvs_spi0_ssin_pins {
          pins = "SPI0_SS_IN";
          input-enable;
          bias-pull-up;
        };
        nvs_spi0_dms_pins {
          pins = "SPI0_DMS";
          output-enable;
          drive-strength = <7>;
        };
      };
    };

    // Pin configuration consumer
    nvs_spi0: spi@0x04088000 {
      #address-cells = <1>;
      #size-cells = <0>;
      compatible = "snps,dwc-ssi-1.01a";
      reg = <0x0 0x04088000 0x0 0x100>;
      interrupts = <GIC_SPI 32 IRQ_TYPE_LEVEL_HIGH>;
      clocks = <&nvs_spi_clk>, <&nvs_spi_clk>;
      clock-names = "ssi_clk", "pclk";
      spi-max-frequency = <50000000>;
      num-cs = <4>;
      reg-io-width = <4>;
      pinctrl-0 = <&pins_nvs_spi0_deafult>;
      pinctrl-names = "default";
      dmas = <&nvs_dmac 0>, <&nvs_dmac 1>;
      dma-names = "tx", "rx";
      status = "disabled";
    };
```

## Documentation/devicetree/bindings/pinctrl/simaai,pinctrl-sio.yaml
```yaml
# SPDX-License-Identifier: (GPL-2.0-only OR BSD-2-Clause)
%YAML 1.2
---
$id: "http://devicetree.org/schemas/pinctrl/simaai,pinctrl-sio.yaml#"
$schema: "http://devicetree.org/meta-schemas/core.yaml#"

title: Driver for the SiMa.ai SIO's Pin Control and Muxer Device

maintainers:
  - Yurii Konovalenko <yurii.konovalenko@sima.ai>

description: |
  SiMa.ai SIO Pin Control Driver

properties:
  compatible:
    enum:
      - simaai,pinctrl-sio
    description:  For SiMa.ai SIO pin controller, should be "simaai,pinctrl-sio"

  reg:
    items:
      - description: SIO control registers region
      - description: GPIO SWPORTA_CTL register region

  reg-names:
    items:
      - const: ctl
      - const: gpio

#PIN CONFIGURATION NODES
patternProperties:
  'pinmux$':
    oneOf:
      - $ref: "#/$defs/simaai-pin-conf"
      - patternProperties:
          ".*":
            $ref: "#/$defs/simaai-pin-conf"

'$defs':
  simaai-pin-conf:
    type: object
    description:
      Pinctrl node's client devices use subnodes for desired pin configuration.
      Client device subnodes use below standard properties.
    $ref: "#/$defs/simaai-pin-conf"

    properties:
      pins:
        description:
          List of pins affected by the properties specified in this subnode.
        items:
          - enum: [ PIN0, PIN1, PIN2, PIN3, PIN4, PIN5, PIN6, PIN7 ]
        minItems: 1
        maxItems: 8

      pinfroups:
        description:
          List of pin groups affected by the properties specified in this subnode.
        items:
          - enum: [ spi0_group, spi1_group, i2c0_group, i2c1_group, i2c2_group, i2c3_group,
                    uart0_group, uart1_group, uart2_group, uart3_group, gpio0_group, gpio1_group,
                    gpio2_group, gpio3_group, gpio4_group, gpio5_group, gpio6_group, gpio7_group ]
      function:
        description:
          Specify the function to be configured for the specified pins.

        enum: [ spi, i2c, uart, gpio ]

      drive-strength:
        enum: [0, 1, 2, 3, 4, 5, 6, 7, 8, 9, 10, 11, 12, 13, 14, 15]
        default: 0
        description:
          Selects the drive strength for the specified pins, in mA.

      bias-pull-down: true

      bias-pull-up: true

      bias-disable: true

      drive-open-drain: true

      slew-rate: true

      input-enable: true

      output-enable: true

      simaai,retention:
        description: enable retention.
        type: boolean

      simaai,hysteresys:
        description: enable hysteresis.
        type: boolean

      simaai,drive-open-drain-polarity:
        description: change open darain emulation polarity.
        type: boolean

    required:
      oneOf:
        - pins
        - groups
      - function

    additionalProperties: false

allOf:
  - $ref: "pinctrl.yaml#"

required:
  - compatible
  - reg

additionalProperties: false

examples:
  - |
    #include <dt-bindings/pinctrl/pinctrl-simaai-sio.h>
    // Pin configuration provider
		pinmux00: pinmux@0x0400000 {
			compatible = "simaai,pinctrl-sio";
			reg = <0x0 0x04000000 0 0x208>;

			pin03_default: pin03 {
				pins = "PIN3";
				bias-pull-up;
				drive-strength = <7>;
			};

			pins_uart00_deafult: pins_uart00 {
				function = "uart";
				groups = "uart0_group";
			};
    };

    // Pin configuration consumer
    uart00: uart@0x04006000 {
      compatible = "snps,dw-apb-uart";
      reg = <0x0 0x04006000 0x0 0x100>;
      interrupts = <GIC_SPI 282 IRQ_TYPE_LEVEL_HIGH>;
      reg-io-width = <4>;
      reg-shift = <2>;
      clocks = <&sio00_clk SIMAAI_SIO_DEV_UART0>;
      resets = <&reset00 SIMAAI_SIO_DEV_UART0>;
      pinctrl-0 = <&pins_uart00_deafult>;
      pinctrl-names = "default";
      status = "disabled";
    };
```

## Documentation/devicetree/bindings/reset/simaai,reset-sio.yaml
```yaml
# SPDX-License-Identifier: (GPL-2.0-only OR BSD-2-Clause)
%YAML 1.2
---
$id: "http://devicetree.org/schemas/reset/simaai,reset-sio.yaml#"
$schema: "http://devicetree.org/meta-schemas/core.yaml#"

title: SiMa.ai SIO Reset Controller Driver

maintainers:
  - Yurii Konovalenko <yurii.konovalenko@sima.ai>

description: |
  The SiMai.ai SIO Reset controller driver.

properties:
  compatible:
    enum:
      - simaai,reset-sio
    description: For SiMa.ai SIO reset controller, should be "simaai,reset-sio"

  reg:
    maxItems: 1

  "#reset-cells":
    const: 1
    description:
      See table below for valid peripheral reset numbers.
      Reset	      Define          Peripheral
        0	  SIMAAI_SIO_DEV_SPI0      SPI 0
        1   SIMAAI_SIO_DEV_SPI1      SPI 1
        2   SIMAAI_SIO_DEV_I2C0      I2C 0
        3   SIMAAI_SIO_DEV_I2C1      I2C 1
        4   SIMAAI_SIO_DEV_I2C2      I2C 2
        5   SIMAAI_SIO_DEV_I2C3      I2C 3
        6   SIMAAI_SIO_DEV_UART0     UART 0
        7   SIMAAI_SIO_DEV_UART1     UART 1
        8   SIMAAI_SIO_DEV_UART2     UART 2
        9   SIMAAI_SIO_DEV_UART3     UART 3

required:
  - compatible
  - reg
  - "#reset-cells"

additionalProperties: false

examples:
  - |
    #include <dt-bindings/pinctrl/pinctrl-simaai-sio.h>
    // Reset provider
    reset00: reset@0x0400210 {
      compatible = "simaai,reset-sio";
      reg = <0x0 0x04000210 0 0x8>;
      #reset-cells = <1>;
    };

    // Reset consumer
    uart00: uart@0x04006000 {
      compatible = "snps,dw-apb-uart";
      reg = <0x0 0x04006000 0x0 0x100>;
      interrupts = <GIC_SPI 282 IRQ_TYPE_LEVEL_HIGH>;
      reg-io-width = <4>;
      reg-shift = <2>;
      clocks = <&sio00_clk SIMAAI_SIO_DEV_UART0>;
      resets = <&reset00 SIMAAI_SIO_DEV_UART0>;
      pinctrl-0 = <&pins_uart00_deafult>;
      pinctrl-names = "default";
      status = "disabled";
    };
```

## arch/arm64/configs/simaai_davinci_defconfig
```kconfig
CONFIG_SYSVIPC=y
CONFIG_POSIX_MQUEUE=y
CONFIG_AUDIT=y
CONFIG_NO_HZ_IDLE=y
CONFIG_HIGH_RES_TIMERS=y
CONFIG_BPF_JIT=y
CONFIG_PREEMPT=y
CONFIG_IRQ_TIME_ACCOUNTING=y
CONFIG_BSD_PROCESS_ACCT=y
CONFIG_BSD_PROCESS_ACCT_V3=y
CONFIG_TASKSTATS=y
CONFIG_TASK_DELAY_ACCT=y
CONFIG_TASK_XACCT=y
CONFIG_TASK_IO_ACCOUNTING=y
CONFIG_IKCONFIG=y
CONFIG_IKCONFIG_PROC=y
CONFIG_NUMA_BALANCING=y
CONFIG_MEMCG=y
CONFIG_BLK_CGROUP=y
CONFIG_CGROUP_PIDS=y
CONFIG_CGROUP_HUGETLB=y
CONFIG_CPUSETS=y
CONFIG_CGROUP_DEVICE=y
CONFIG_CGROUP_CPUACCT=y
CONFIG_CGROUP_PERF=y
CONFIG_USER_NS=y
CONFIG_SCHED_AUTOGROUP=y
CONFIG_BLK_DEV_INITRD=y
CONFIG_KALLSYMS_ALL=y
CONFIG_PROFILING=y
CONFIG_ARCH_SIMAAI_DAVINCI=y
CONFIG_ARM64_VA_BITS_48=y
CONFIG_SCHED_MC=y
CONFIG_NR_CPUS=32
CONFIG_NUMA=y
CONFIG_KEXEC=y
CONFIG_CRASH_DUMP=y
CONFIG_COMPAT=y
# CONFIG_ARM64_PTR_AUTH is not set
CONFIG_RANDOMIZE_BASE=y
CONFIG_HIBERNATION=y
CONFIG_WQ_POWER_EFFICIENT_DEFAULT=y
CONFIG_CPU_IDLE=y
CONFIG_CPU_FREQ=y
CONFIG_CPU_FREQ_STAT=y
CONFIG_CPU_FREQ_GOV_POWERSAVE=m
CONFIG_CPU_FREQ_GOV_USERSPACE=y
CONFIG_CPU_FREQ_GOV_ONDEMAND=y
CONFIG_CPU_FREQ_GOV_CONSERVATIVE=m
CONFIG_CPUFREQ_DT=y
CONFIG_KPROBES=y
CONFIG_JUMP_LABEL=y
CONFIG_MODULES=y
CONFIG_MODULE_UNLOAD=y
CONFIG_BLK_DEV_INTEGRITY=y
# CONFIG_CORE_DUMP_DEFAULT_ELF_HEADERS is not set
CONFIG_KSM=y
CONFIG_MEMORY_FAILURE=y
CONFIG_TRANSPARENT_HUGEPAGE=y
CONFIG_CMA=y
CONFIG_NET=y
CONFIG_PACKET=y
CONFIG_UNIX=y
CONFIG_INET=y
CONFIG_IP_MULTICAST=y
CONFIG_IP_PNP=y
CONFIG_IP_PNP_DHCP=y
CONFIG_IP_PNP_BOOTP=y
CONFIG_IPV6=m
CONFIG_NETFILTER=y
CONFIG_NF_CONNTRACK=m
CONFIG_NF_CONNTRACK_EVENTS=y
CONFIG_NETFILTER_XT_TARGET_CHECKSUM=m
CONFIG_NETFILTER_XT_TARGET_LOG=m
CONFIG_NETFILTER_XT_MATCH_ADDRTYPE=m
CONFIG_NETFILTER_XT_MATCH_CONNTRACK=m
CONFIG_IP_NF_IPTABLES=m
CONFIG_IP_NF_FILTER=m
CONFIG_IP_NF_TARGET_REJECT=m
CONFIG_IP_NF_NAT=m
CONFIG_IP_NF_TARGET_MASQUERADE=m
CONFIG_IP_NF_MANGLE=m
CONFIG_IP6_NF_IPTABLES=m
CONFIG_IP6_NF_FILTER=m
CONFIG_IP6_NF_TARGET_REJECT=m
CONFIG_IP6_NF_MANGLE=m
CONFIG_IP6_NF_NAT=m
CONFIG_IP6_NF_TARGET_MASQUERADE=m
CONFIG_BRIDGE=m
CONFIG_AF_KCM=y
CONFIG_RFKILL=m
CONFIG_NET_9P=y
CONFIG_PCI=y
CONFIG_PCIEPORTBUS=y
CONFIG_PCI_DEBUG=y
CONFIG_PCI_IOV=y
CONFIG_HOTPLUG_PCI=y
CONFIG_PCI_HOST_GENERIC=y
CONFIG_PCI_XGENE=y
CONFIG_PCIE_ALTERA=y
CONFIG_PCIE_ALTERA_MSI=y
CONFIG_PCI_HOST_THUNDER_PEM=y
CONFIG_PCI_HOST_THUNDER_ECAM=y
CONFIG_PCI_HISI=y
CONFIG_PCIE_KIRIN=y
CONFIG_PCI_ENDPOINT=y
CONFIG_PCI_ENDPOINT_CONFIGFS=y
CONFIG_DEVTMPFS=y
CONFIG_DEVTMPFS_MOUNT=y
CONFIG_FW_LOADER_USER_HELPER=y
CONFIG_FW_LOADER_USER_HELPER_FALLBACK=y
CONFIG_ARM_SCPI_PROTOCOL=y
CONFIG_EFI_CAPSULE_LOADER=y
CONFIG_OF_OVERLAY=y
CONFIG_BLK_DEV_LOOP=y
CONFIG_BLK_DEV_NBD=m
CONFIG_SRAM=y
CONFIG_SIMAAI_MEMORY=y
CONFIG_NETDEVICES=y
CONFIG_TUN=y
CONFIG_STMMAC_ETH=y
CONFIG_MDIO_BUS_MUX_MMIOREG=y
# CONFIG_WLAN is not set
CONFIG_NET_FAILOVER=y
CONFIG_INPUT_EVDEV=y
CONFIG_KEYBOARD_GPIO=y
CONFIG_INPUT_MISC=y
# CONFIG_SERIO_SERPORT is not set
CONFIG_SERIO_AMBAKMI=y
CONFIG_VT_HW_CONSOLE_BINDING=y
CONFIG_LEGACY_PTY_COUNT=16
CONFIG_SERIAL_8250=y
CONFIG_SERIAL_8250_CONSOLE=y
# CONFIG_SERIAL_8250_PCI is not set
CONFIG_SERIAL_8250_EXTENDED=y
CONFIG_SERIAL_8250_SHARE_IRQ=y
CONFIG_SERIAL_8250_DW=y
CONFIG_SERIAL_OF_PLATFORM=y
CONFIG_SERIAL_DEV_BUS=y
CONFIG_VIRTIO_CONSOLE=y
CONFIG_I2C=y
CONFIG_I2C_CHARDEV=y
CONFIG_I2C_MUX=y
CONFIG_I2C_DESIGNWARE_PLATFORM=y
CONFIG_I2C_GPIO=m
CONFIG_I2C_SLAVE=y
CONFIG_SPI=y
CONFIG_SPI_MEM=y
CONFIG_SPI_BITBANG=m
CONFIG_SPI_SPIDEV=m
CONFIG_SPMI=y
CONFIG_GPIOLIB=y
CONFIG_GPIO_DWAPB=y
# CONFIG_HWMON is not set
CONFIG_THERMAL=y
CONFIG_THERMAL_EMULATION=y
CONFIG_WATCHDOG=y
CONFIG_DW_WATCHDOG=y
CONFIG_REGULATOR=y
CONFIG_REGULATOR_SIMAAIPRC=y
CONFIG_HARDWARE_ACCELERATION=y
CONFIG_ALLEGRO_CODEC_DRIVER=y
# CONFIG_USB_SUPPORT is not set
CONFIG_MMC=y
CONFIG_MMC_BLOCK_MINORS=32
CONFIG_MMC_SDHCI=y
CONFIG_MMC_SDHCI_PLTFM=y
CONFIG_MMC_SDHCI_OF_DWCMSHC=y
CONFIG_MMC_SPI=y
CONFIG_MMC_CQHCI=y
CONFIG_EDAC=y
CONFIG_EDAC_SYNOPSYS=y
CONFIG_RTC_CLASS=y
CONFIG_RTC_DRV_EFI=y
CONFIG_DMADEVICES=y
CONFIG_DW_AXI_DMAC=m
CONFIG_DMATEST=m
CONFIG_SYNC_FILE=y
# CONFIG_VIRTIO_MENU is not set
CONFIG_HWSPINLOCK=y
CONFIG_MAILBOX=y
CONFIG_ARM_MHU=y
CONFIG_PLATFORM_MHU=y
CONFIG_SIMAAI_MBOX=y
CONFIG_SIMAAI_HPI=y
# CONFIG_IOMMU_SUPPORT is not set
CONFIG_REMOTEPROC=y
CONFIG_SIMAAI_REMOTEPROC_EV=m
CONFIG_SIMAAI_REMOTEPROC_M4=m
CONFIG_GENERIC_PHY=y
# CONFIG_NVMEM_SYSFS is not set
CONFIG_TEE=y
CONFIG_OPTEE=y
CONFIG_COUNTER=y
CONFIG_DW_TIMER_CNT=y
CONFIG_EXT2_FS=y
CONFIG_EXT3_FS=y
CONFIG_EXT4_FS_POSIX_ACL=y
CONFIG_BTRFS_FS=m
CONFIG_BTRFS_FS_POSIX_ACL=y
CONFIG_FANOTIFY=y
CONFIG_FANOTIFY_ACCESS_PERMISSIONS=y
CONFIG_QUOTA=y
CONFIG_AUTOFS4_FS=y
CONFIG_FUSE_FS=m
CONFIG_CUSE=m
CONFIG_OVERLAY_FS=m
CONFIG_VFAT_FS=y
CONFIG_TMPFS=y
CONFIG_HUGETLBFS=y
CONFIG_EFIVAR_FS=y
CONFIG_SQUASHFS=y
CONFIG_PSTORE=y
CONFIG_NFS_FS=y
CONFIG_NFS_V4=y
CONFIG_NFS_V4_1=y
CONFIG_NFS_V4_2=y
CONFIG_ROOT_NFS=y
CONFIG_NLS_CODEPAGE_437=y
CONFIG_NLS_ISO8859_1=y
CONFIG_SECURITY=y
CONFIG_CRYPTO_AUTHENC=m
CONFIG_CRYPTO_ECHAINIV=y
CONFIG_CRYPTO_MD5=m
CONFIG_CRYPTO_ANSI_CPRNG=y
CONFIG_CRYPTO_CHACHA20_NEON=m
CONFIG_CRYPTO_GHASH_ARM64_CE=y
CONFIG_CRYPTO_SHA1_ARM64_CE=y
CONFIG_CRYPTO_SHA2_ARM64_CE=y
CONFIG_CRYPTO_SHA512_ARM64_CE=m
CONFIG_CRYPTO_SHA3_ARM64=m
CONFIG_CRYPTO_SM3_ARM64_CE=m
CONFIG_CRYPTO_AES_ARM64_CE_BLK=y
CONFIG_CRYPTO_AES_ARM64_BS=m
CONFIG_CRYPTO_AES_ARM64_CE_CCM=y
CONFIG_DMA_CMA=y
CONFIG_PRINTK_TIME=y
CONFIG_DEBUG_KERNEL=y
CONFIG_MAGIC_SYSRQ=y
CONFIG_DEBUG_FS=y
# CONFIG_SCHED_DEBUG is not set
# CONFIG_DEBUG_PREEMPT is not set
# CONFIG_STRICT_DEVMEM is not set
CONFIG_MEMTEST=y
```
