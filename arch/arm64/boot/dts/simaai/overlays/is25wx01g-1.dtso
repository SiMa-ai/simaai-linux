// SPDX-License-Identifier: (GPL-2.0+ OR MIT)
/*
 * Copyright (c) 2026 SiMa ai
 */

/dts-v1/;
/plugin/;

&nvs_spi1 {
    spi-max-frequency = <25000000>;
    status = "okay";
    flash@0 {
        compatible = "issi,is25wx01g", "jedec,spi-nor";
        reg = <0>;
        spi-max-frequency = <25000000>;
        spi-tx-bus-width = <8>;
        spi-rx-bus-width = <8>;
    };
};
