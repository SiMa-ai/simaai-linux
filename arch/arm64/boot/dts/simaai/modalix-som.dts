// SPDX-License-Identifier: (GPL-2.0+ OR MIT)
/*
 * Copyright (c) 2025 SiMa ai
 */

/dts-v1/;

#include "modalix.dtsi"
#include "modalix-som-common.dtsi"

/ {
	model = "SiMa.ai Modalix SoM Board";

	memory@1000000000 {
		device_type = "memory";
		reg = < 0x00000010 0x00000000 0x00000000 0x6FC00000
				0x00000010 0x75000000 0x00000002 0x8B000000>;
	};
};

&dms0_reserved {
	reg = <0x00000013 0x00000000 0x00000004 0x00000000>;
};

