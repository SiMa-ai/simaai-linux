// SPDX-License-Identifier: (GPL-2.0+ OR MIT)
/*
 * Copyright (c) 2025 SiMa ai
 */

/dts-v1/;

#include "modalix.dtsi"
#include "modalix-som-common.dtsi"

/ {
	model = "SiMa.ai Modalix SoM 8Gig Board";

	memory@1000000000 {
		device_type = "memory";
		reg = < 0x00000010 0x00000000 0x00000000 0x6FC00000
				0x00000010 0x75000000 0x00000000 0xAB000000>;
	};
};

&dms0_reserved {
	reg = <0x00000011 0x20000000 0x00000000 0xA0000000>;
};

